## main/Kconfig.projbuild
```kconfig
menu "Bootloader Launcher Configuration"

    menu "Slots / partitions"

        config LAUNCHER_APP_SLOT_SIZE
            hex "Size of each slot (bytes)"
            default 0x180000
            help
                Size applied to each app partition. Must match what's declared in
                partitions.csv (or partitions_4mb.csv).

        config LAUNCHER_FACTORY_SIZE
            hex "Size of the factory partition (launcher)"
            default 0x180000
            help
                Must match what's declared in partitions.csv.
                0x180000 (1.5MB) rather than the more usual 1MB because enabling
                LAUNCHER_NET_OTA_ENABLE + LAUNCHER_NET_VERSION_CHECK_ENABLE +
                LAUNCHER_NET_REMOTE_CONTROL_ENABLE (BLE) all at once measures
                around 1.25MB once built (WiFi+TLS+HTTP+JSON alone already
                approach 1MB, NimBLE adds ~250-300KB more).
                Reduce if the network features aren't used.

    endmenu

    menu "Navigation (HAL)"

        choice LAUNCHER_NAV_DRIVER
            prompt "Active navigation driver"
            default LAUNCHER_NAV_DRIVER_EC11
            help
                Choice of nav_input_driver_t compiled into the launcher.
                Only one active driver at a time in v1 (no dynamic detection).

            config LAUNCHER_NAV_DRIVER_EC11
                bool "EC11 rotary encoder"

            config LAUNCHER_NAV_DRIVER_BUTTONS
                bool "Push buttons (3x GPIO: up / down / select)"
                help
                    Three momentary buttons to GND (internal pull-ups, active
                    low) for boards with no rotary encoder -- a jumper wire to
                    GND works during bring-up. SELECT: short = select, long =
                    back/cancel, and also serves as the boot-time
                    crash-loop-recovery pin (see LAUNCHER_BUTTONS_GPIO_SELECT).

            config LAUNCHER_NAV_DRIVER_MOCK
                bool "Mock (events simulated from the serial console)"
                help
                    Useful for testing menu logic without hardware connected.
        endchoice

        config LAUNCHER_EC11_GPIO_CLK
            int "EC11 GPIO - CLK (phase A)"
            depends on LAUNCHER_NAV_DRIVER_EC11
            default 4

        config LAUNCHER_EC11_GPIO_DT
            int "EC11 GPIO - DT (phase B)"
            depends on LAUNCHER_NAV_DRIVER_EC11
            default 5

        config LAUNCHER_EC11_GPIO_SW
            int "EC11 GPIO - push button"
            depends on LAUNCHER_NAV_DRIVER_EC11
            default 6
            help
                If changed, also update CONFIG_BOOTLOADER_NUM_PIN_FACTORY_RESET
                in sdkconfig.defaults to match -- the crash-loop-recovery long
                press (issue #23) is checked at the bootloader level on that
                separate, ESP-IDF-native Kconfig symbol, which has no automatic
                link to this one. See README.md "Design decisions".

        config LAUNCHER_EC11_INVERT
            bool "Invert EC11 encoder rotation direction"
            depends on LAUNCHER_NAV_DRIVER_EC11
            default n

        config LAUNCHER_BUTTONS_GPIO_UP
            int "Button GPIO - UP"
            depends on LAUNCHER_NAV_DRIVER_BUTTONS
            default 19

        config LAUNCHER_BUTTONS_GPIO_DOWN
            int "Button GPIO - DOWN"
            depends on LAUNCHER_NAV_DRIVER_BUTTONS
            default 14

        config LAUNCHER_BUTTONS_GPIO_SELECT
            int "Button GPIO - SELECT"
            depends on LAUNCHER_NAV_DRIVER_BUTTONS
            default 13
            help
                Also the crash-loop-recovery pin: hold to GND for
                CONFIG_BOOTLOADER_HOLD_TIME_GPIO seconds at power-on to force
                the menu even against a guest that crashes immediately. Keep
                CONFIG_BOOTLOADER_NUM_PIN_FACTORY_RESET in sdkconfig.defaults
                in sync with this value (same caveat as LAUNCHER_EC11_GPIO_SW).

        config LAUNCHER_LONG_PRESS_MS
            int "Long-press threshold (ms)"
            default 3000
            help
                Shared by the EC11 and the push-button nav drivers.

    endmenu

    menu "Display (SPI TFT: ST7789 / GC9A01)"

        choice LAUNCHER_DISPLAY_DRIVER
            prompt "Panel driver"
            default LAUNCHER_DISPLAY_DRIVER_ST7789
            help
                Which esp_lcd panel driver is compiled in (see display.h --
                the launcher core only ever calls the panel-agnostic
                display_* API). One at a time, chosen at build.

            config LAUNCHER_DISPLAY_DRIVER_ST7789
                bool "ST7789 (e.g. 2.4in 320x240 SPI)"

            config LAUNCHER_DISPLAY_DRIVER_GC9A01
                bool "GC9A01 (1.28in 240x240 round IPS)"
                help
                    Pulls the espressif/esp_lcd_gc9a01 managed component
                    (ESP-IDF's esp_lcd has no built-in GC9A01 driver).
        endchoice

        config LAUNCHER_DISPLAY_GPIO_MOSI
            int "SPI MOSI GPIO"
            default 11

        config LAUNCHER_DISPLAY_GPIO_SCLK
            int "SPI SCLK GPIO"
            default 12

        config LAUNCHER_DISPLAY_GPIO_CS
            int "CS GPIO"
            default 10

        config LAUNCHER_DISPLAY_GPIO_DC
            int "DC GPIO (data/command)"
            default 9

        config LAUNCHER_DISPLAY_GPIO_RST
            int "RESET GPIO"
            default 8

        config LAUNCHER_DISPLAY_GPIO_BL
            int "Backlight GPIO (-1 if not GPIO-driven)"
            default 7

        config LAUNCHER_DISPLAY_WIDTH
            int "Screen width (px)"
            default 240 if LAUNCHER_DISPLAY_DRIVER_GC9A01
            default 320

        config LAUNCHER_DISPLAY_HEIGHT
            int "Screen height (px)"
            default 240

        config LAUNCHER_DISPLAY_SWAP_XY
            bool "Swap rows/columns (swap_xy)"
            default n if LAUNCHER_DISPLAY_DRIVER_GC9A01
            default y
            help
                Most 2.4" ST7789 modules of this type are natively portrait
                (240x320) -- this swap is needed to get a correct landscape
                (320x240) image. Equivalent to TFT_eSPI's setRotation(). If the
                menu appears rotated 90 degrees, try toggling this option.
                Not needed for a square 240x240 GC9A01 (default n there).

        config LAUNCHER_DISPLAY_MIRROR_X
            bool "Horizontal mirror"
            default n if LAUNCHER_DISPLAY_DRIVER_GC9A01
            default y
            help
                Adjust case by case depending on the panel's physical mounting.
                default y confirmed on this project's reference hardware
                (2.4" ST7789 module, see issue #13) -- with
                LAUNCHER_DISPLAY_SWAP_XY=y alone, the image came out horizontally
                flipped (text readable but left/right reversed); SWAP_XY=y +
                MIRROR_X=y + MIRROR_Y=n gives the correct landscape orientation
                with no mirroring on this panel. If the image comes out flipped
                on another module, disable this option.

        config LAUNCHER_DISPLAY_MIRROR_Y
            bool "Vertical mirror"
            default n
            help
                Same as LAUNCHER_DISPLAY_MIRROR_X but for the vertical axis.

    endmenu

    menu "Boot behavior"

        comment "Crash-loop recovery (issue #23) is configured via ESP-IDF's own Bootloader config > Factory reset, not here -- see sdkconfig.defaults and README.md"

        config LAUNCHER_BOOT_SPLASH_MS
            int "Splash duration on direct boot (ms, 0 = disabled)"
            default 300

        config LAUNCHER_NVS_NAMESPACE
            string "NVS namespace shared by launcher/apps"
            default "launcher"

    endmenu

    menu "Network (optional)"

        config LAUNCHER_NET_OTA_ENABLE
            bool "Enable network OTA (HTTP download of a program)"
            default n
            select LAUNCHER_NET_WIFI_ENABLE
            help
                Adds a menu entry to download a .bin binary from
                CONFIG_LAUNCHER_NET_OTA_URL_BASE and write it into an ota_* slot.

        config LAUNCHER_NET_OTA_URL_BASE
            string "Base URL of the OTA server/manifest"
            default ""
            depends on LAUNCHER_NET_OTA_ENABLE || LAUNCHER_NET_VERSION_CHECK_ENABLE
            help
                The launcher will fetch the manifest at "<URL_BASE>/manifest.json"
                (GET, JSON -- see README.md for the expected format). Each
                binary's download URL, though, is taken as-is from the manifest
                (may point elsewhere, e.g. GitHub Releases).

        config LAUNCHER_NET_REMOTE_CONTROL_ENABLE
            bool "Enable remote control of the menu"
            default n
            help
                Allows triggering boot_into() from a network transport (embedded
                HTTP server or BLE) in addition to the local navigation HAL.

        choice LAUNCHER_NET_REMOTE_TRANSPORT
            prompt "Transport for remote control"
            depends on LAUNCHER_NET_REMOTE_CONTROL_ENABLE
            default LAUNCHER_NET_REMOTE_TRANSPORT_HTTP

            config LAUNCHER_NET_REMOTE_TRANSPORT_HTTP
                bool "HTTP server (esp_http_server)"
                select LAUNCHER_NET_WIFI_ENABLE

            config LAUNCHER_NET_REMOTE_TRANSPORT_BLE
                bool "BLE (custom GATT service)"
                depends on SOC_BLE_SUPPORTED
                select BT_ENABLED
                help
                    Does not require CONFIG_LAUNCHER_NET_WIFI_ENABLE -- BLE works
                    independently of the WiFi station connection.

                    IMPORTANT: Kconfig's "select" cannot force a specific member
                    of a choice (a Kconfig limitation, not a bug here -- see
                    README.md). After picking this transport you must also go to
                    "Component config > Bluetooth > Host" and select "NimBLE -
                    BLE only" yourself (Bluedroid, the default, is a different
                    API and net_remote_ble.c will not build against it). On
                    classic ESP32 also set "Component config > Bluetooth >
                    Controller > Mode" to "BLE Only" to avoid pulling in unused
                    BR/EDR support.
        endchoice

        config LAUNCHER_NET_REMOTE_PIN
            string "PIN/token for remote control (optional)"
            default ""
            depends on LAUNCHER_NET_REMOTE_CONTROL_ENABLE
            help
                Deters accidental/opportunistic use on the local network. Do not
                consider this robust security -- trusted-network use only (home
                network, no Internet exposure).

        config LAUNCHER_NET_VERSION_CHECK_ENABLE
            bool "Enable remote version checking"
            default n
            select LAUNCHER_NET_WIFI_ENABLE
            help
                Compares each slot's version (esp_app_desc_t) against a remote
                manifest and shows an indicator in the menu. Does not trigger any
                automatic download.

        config LAUNCHER_NET_WIFI_ENABLE
            bool "Enable the WiFi subsystem"
            default n
            help
                Automatically forced to y as soon as OTA, version checking, or
                remote control over the HTTP transport is active (see "select" on
                each -- the BLE transport doesn't need WiFi). Credentials handled
                via NVS (never hardcoded/committed), with an optional dev
                fallback below -- see README.

        config LAUNCHER_NET_WIFI_SSID
            string "WiFi SSID (dev fallback only, prefer NVS at runtime)"
            default ""
            depends on LAUNCHER_NET_WIFI_ENABLE
            help
                Only used if no credential is already present in NVS. Put this
                value in an uncommitted sdkconfig.local (see .gitignore / README)
                rather than committing a real SSID/password to
                sdkconfig.defaults.

        config LAUNCHER_NET_WIFI_PASSWORD
            string "WiFi password (dev fallback only)"
            default ""
            depends on LAUNCHER_NET_WIFI_ENABLE

        config LAUNCHER_NET_TASK_STACK_SIZE
            int "Stack size for network operations (bytes)"
            default 16384
            depends on LAUNCHER_NET_WIFI_ENABLE || LAUNCHER_NET_REMOTE_TRANSPORT_BLE
            help
                WiFi/BLE init + TLS/HTTP/cJSON (mbedtls, esp_http_client, cJSON)
                consume significantly more stack than the rest of the launcher.
                A stack overflow was observed on the default
                CONFIG_ESP_MAIN_TASK_STACK_SIZE (3584) when these operations ran
                inline on the "main" task (see issue #14) -- they now run on a
                dedicated task with this stack size instead.

                8192 was the original default, but real-hardware testing with
                BLE remote control + OTA + version-check all enabled
                (a perfectly ordinary combination, not an edge case) hit a
                reproducible stack overflow in this task right after WiFi
                connected, and a related spinlock-corruption assert during
                the OTA download flow -- both on the same undersized task
                stack, both cleared by raising this default to 16384.
                Increase further if a stack overflow (or an otherwise
                unexplained low-level assert -- stack corruption doesn't
                always trip FreeRTOS's own overflow canary) reappears with
                an even heavier combination of features.

    endmenu

endmenu
```
